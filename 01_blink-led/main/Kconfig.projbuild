## 01_blink-led/main/Kconfig.projbuild
```kconfig
menu "Example Configuration"

    config LED_PIN
        int "Blink Led GPIO Pin Number"
        range 0 39
        default 2
        help
            GPIO number (IOxx) of the lovely blinking LED

    config LED_DELAY
        int "Blink Led HIGH and LOW time in ms"
        default 1000
        help
            Blinking LED HIGH and LOW time in milliseconds

endmenu
```

## 07_semaphore/main/Kconfig.projbuild
```kconfig
menu "Example Configuration"

    config KEY1_PIN
        int "Key 1 GPIO Pin Number"
        range 0 39
        default 0
        help
            GPIO number (IOxx) of the user Key 1

    config LED1_PIN
        int "Blink Led 1 GPIO Pin Number"
        range 0 39
        default 2
        help
            GPIO number (IOxx) of the lovely blinking LED 1

    config LED2_PIN
        int "Blink Led 2 GPIO Pin Number"
        range 0 39
        default 13
        help
            GPIO number (IOxx) of the lovely blinking LED 2

    config LED_DELAY
        int "Blink Led HIGH and LOW time in ms"
        default 1000
        help
            Blinking LED HIGH and LOW time in milliseconds

endmenu
```

## 09_wifi-scan/main/Kconfig.projbuild
```kconfig
menu "Example Configuration"

    config KEY1_PIN
        int "Key 1 GPIO Pin Number"
        range 0 39
        default 0
        help
            GPIO number (IOxx) of the user Key 1

    config LED1_PIN
        int "Blink Led 1 GPIO Pin Number"
        range 0 39
        default 2
        help
            GPIO number (IOxx) of the lovely blinking LED 1

    config LED2_PIN
        int "Blink Led 2 GPIO Pin Number"
        range 0 39
        default 13
        help
            GPIO number (IOxx) of the lovely blinking LED 2

    config LED_DELAY
        int "Blink Led HIGH and LOW time in ms"
        default 1000
        help
            Blinking LED HIGH and LOW time in milliseconds

    config WIFI_SCAN_LIST_SIZE
        int "Max size of WiFi scan list"
        range 0 20
        default 10
        help
            The size of array that will be used to retrieve the list of WiFi access points.

endmenu
```
